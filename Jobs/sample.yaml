## Jobs/sample.yaml
```yaml
reference:
  class: File
  format: http://edamontology.org/format_1929
  path: /home/fujino/data/genomon/_GRCh37/reference/GRCh37/GRCh37.fa
fastq1:
  class: File
  format: http://edamontology.org/format_1930
  path: /home/fujino/data/genomon/_GRCh37/sample/dna/simulate_N_read1.fq
fastq2:
  class: File
  format: http://edamontology.org/format_1930
  path: /home/fujino/data/genomon/_GRCh37/sample/dna/simulate_N_read2.fq
nthreads: 4
sample: sample
bwa_min_score: 0
```
